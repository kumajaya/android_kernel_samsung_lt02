## arch/arm/configs/blackhawk_lt02wifi_defconfig
```kconfig
CONFIG_WIFIONLY_BOARD=y
CONFIG_GPADC0_CURRENT_SINK_MODE=y
# CONFIG_VIBRATOR_ANDROID is not set
# CONFIG_ANDROID_TIMED_GPIO is not set
CONFIG_SEC_IRLED=y
# CONFIG_SENSORS_ASP01 is not set
```

## arch/arm/configs/pxa986_lt023gdtv_defconfig
```kconfig
# CONFIG_WIFIONLY_BOARD is not set
# CONFIG_NF_CONNTRACK_FTP is not set
# CONFIG_NF_NAT_FTP is not set
CONFIG_VIBRATOR_ANDROID=y
CONFIG_ANDROID_TIMED_GPIO=y
# CONFIG_SEC_IRLED is not set
CONFIG_SENSORS_ASP01=y
# CONFIG_J4FS_USE_XSR is not set
# CONFIG_J4FS_USE_FSR is not set
# CONFIG_J4FS_USE_MOVI is not set

#Latin Mobile TV
CONFIG_ISDBT=y
CONFIG_ISDBT_FC8150=y
```

## arch/arm/configs/pxa986_lt02wifidtv_defconfig
```kconfig
CONFIG_WIFIONLY_BOARD=y
# CONFIG_NF_CONNTRACK_FTP is not set
# CONFIG_NF_NAT_FTP is not set
# CONFIG_VIBRATOR_ANDROID is not set
# CONFIG_SEC_IRLED is not set
# CONFIG_J4FS_USE_XSR is not set
# CONFIG_J4FS_USE_FSR is not set
# CONFIG_J4FS_USE_MOVI is not set

#Latin Mobile TV
CONFIG_ISDBT=y
CONFIG_ISDBT_FC8150=y
```

## arch/arm/configs/pxa986_lt02wifilgt_defconfig
```kconfig
CONFIG_WIFIONLY_BOARD=y
CONFIG_MACH_LT02LGT=y
# CONFIG_NF_CONNTRACK_FTP is not set
# CONFIG_NF_NAT_FTP is not set
CONFIG_NFC_PN547=y
CONFIG_VIBRATOR_ANDROID=y
CONFIG_ANDROID_TIMED_GPIO=y
CONFIG_GPADC0_CURRENT_SINK_MODE=y
# CONFIG_SENSORS_ATSN01P is not set
# CONFIG_J4FS_USE_XSR is not set
# CONFIG_J4FS_USE_FSR is not set
# CONFIG_J4FS_USE_MOVI is not set
```

## drivers/marvell/Kconfig
```kconfig
#
# Marvell in-kernel driver configuration
#

menuconfig MARVELL_IN_KERNEL
	bool "Marvell in-kernel driver support for Tab 3 7.0"
	depends on MACH_LT02

if MARVELL_IN_KERNEL

config MARVELL_IN_KERNEL_GC1000
	bool "Use in-kernel GC1000 GPU driver"

config MARVELL_IN_KERNEL_SD8787
	bool "Use in-kernel SD8787 driver for wireless support"

config MARVELL_IN_KERNEL_TELEPHONY
	bool "Use in-kernel telephony driver"

config MARVELL_IN_KERNEL_GEU
	bool "Use in-kernel Generic Encrypt Uint driver"

config MARVELL_IN_KERNEL_PHYSRW
	bool "Use in-kernel physrw driver"

endif # MARVELL_IN_KERNEL
```

## drivers/staging/zcache/Kconfig
```kconfig
config ZCACHE
	bool "Dynamic compression of swap pages and clean pagecache pages"
	# arch dependency is because of the use of local_unmap_kernel_range
	# functions
	depends on (CLEANCACHE || FRONTSWAP) && CRYPTO=y && (ARM || MIPS || SUPERH)
	select ZSMALLOC
	select CRYPTO_LZO
	default n
	help
	  Zcache doubles RAM efficiency while providing a significant
	  performance boosts on many workloads.  Zcache uses
	  compression and an in-kernel implementation of transcendent
	  memory to store clean page cache pages and swap in RAM,
	  providing a noticeable reduction in disk I/O.
```

## drivers/staging/zsmalloc/Kconfig
```kconfig
config ZSMALLOC
	tristate "Memory allocator for compressed pages"
	# arch dependency is because of the use of local_unmap_kernel_range
	# in zsmalloc-main.c.
	# TODO: implement local_unmap_kernel_range in all architecture.
	depends on (ARM || MIPS || SUPERH)
	default n
	help
	  zsmalloc is a slab-based memory allocator designed to store
	  compressed RAM pages.  zsmalloc uses virtual memory mapping
	  in order to reduce fragmentation.  However, this results in a
	  non-standard allocator interface where a handle, not a pointer, is
	  returned by an alloc().  This handle must be mapped in order to
	  access the allocated space.
```
